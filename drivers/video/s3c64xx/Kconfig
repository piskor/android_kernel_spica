## drivers/video/s3c64xx/Kconfig
```kconfig
#
# S3C Video configuration
#

config FB_S3C64XX
	tristate "S3C Framebuffer support"
	select FB_CFB_FILLRECT
	select FB_CFB_COPYAREA
	select FB_CFB_IMAGEBLIT
	depends on FB && ARCH_S3C64XX
	default n
	---help---
	  This enables support for Samsung Display Controller (FIMD)

choice
depends on FB_S3C64XX
prompt "Select BPP(Bits Per Pixel)"
default FB_S3C64XX_BPP_16
config FB_S3C64XX_BPP_8
	bool "8 BPP"
	---help---
	TBA

config FB_S3C64XX_BPP_16
	bool "16 BPP"
	---help---
	TBA

config FB_S3C64XX_BPP_24
	bool "24 BPP"
	---help---
	TBA
endchoice

config FB_S3C64XX_NUM
	int "Number of Framebuffers"
	depends on FB_S3C64XX
	default "1"
	---help---
	TBA

config FB_S3C64XX_VIRTUAL_SCREEN
	bool "Enable Virtual Screen"
	depends on FB_S3C64XX

	default n
	---help---
	TBA

config FB_S3C64XX_DOUBLE_BUFFERING
	bool "Enable Double Buffering"
	depends on FB_S3C64XX

	default n
	---help---
	TBA

config FB_S3C64XX_SHOW_LOGO
	bool "Show full screen logo with progress bar"
	depends on FB_S3C64XX

	default y
	---help---
	TBA

config FB_S3C64XX_KEEP_POWER_ON_SHUTDOWN
	bool "Don't disable LCD screen on system shutdown"
	depends on FB_S3C64XX

	default n
	---help---
	TBA

choice
depends on FB_S3C64XX
prompt "Select LCD Type"
default FB_S3C64XX_S6D05A
config FB_S3C64XX_S6D04D1
	bool "S6D04D1"
	---help---
	  This enables support for Samsung S6D04D1 LCD panel

config FB_S3C64XX_S6D05A
	bool "S6D05A"
	---help---
	  This enables support for Samsung S6D05A LCD panel
endchoice
```
